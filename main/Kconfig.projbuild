## main/Kconfig.projbuild
```kconfig
menu "PlaiiinLightOS Configuration"

    config PLAIIIN_NODE_NAME
        string "Node name"
        default "PlaiiinLight-01"
        help
            Unique name for this lamp node.

    config PLAIIIN_VENDOR_NAME
        string "Vendor name"
        default "PlaiiinLight"

    config PLAIIIN_FIRMWARE_VERSION
        string "Firmware version (dot-separated)"
        default "1.0.0"
        help
            Bumped per release, read by /api. Normally overridden at build
            time from ../version.properties — don't edit by hand.

    config PLAIIIN_API_VERSION
        string "API version (dot-separated)"
        default "1.0.0"
        help
            Reported by /api. Overridden at build time from version.properties.

    menu "LED Strip"
        config PLAIIIN_LED_PIN
            int "LED data GPIO pin"
            default 2
            help
                GPIO pin connected to the LED strip data line.

        config PLAIIIN_LED_CLK_PIN
            int "LED clock GPIO pin (two-wire chips only, e.g. SK9822)"
            default -1
            help
                GPIO pin for the clock line on two-wire LEDs like SK9822.
                Leave -1 for one-wire chips (WS2812/SK6812).

        config PLAIIIN_LED_COUNT
            int "Number of LEDs"
            default 30
            range 1 1024

        config PLAIIIN_LED_TYPE
            string "LED type"
            default "ws2812"
            help
                LED driver identifier. Supported:
                  "ws2812"   — one-wire WS2812/WS2812B/NeoPixel (GRB, 3 bytes/LED)
                  "sk6812"   — one-wire SK6812 RGB (GRB, 3 bytes/LED)
                  "sk6812w"  — one-wire SK6812 RGBW (GRBW, 4 bytes/LED)
                  "sk9822"   — two-wire (data+clock, BGR+brightness)

        config PLAIIIN_LAMP_TYPE
            string "Lamp type"
            default "strip"
            help
                Form factor identifier reported over HTTP. Examples:
                "strip", "matrix8x8", "matrix16x16".

        config PLAIIIN_FORM
            string "Lamp enclosure"
            default "bare"
            help
                Physical enclosure label. Examples: "bare", "tower", "display".
    endmenu

    menu "WiFi"
        config PLAIIIN_NETWORK_SSID
            string "Default STA SSID"
            default ""
            help
                Pre-configured WiFi network the device should try to join on
                first boot. Leave empty to force captive-portal provisioning.

        config PLAIIIN_NETWORK_PW
            string "Default STA password"
            default ""
            help
                Password for the pre-configured network. Leave empty for open.

        config PLAIIIN_WIFI_AP_SSID_PREFIX
            string "SoftAP SSID prefix"
            default "PlaiiinLight"
            help
                Prefix for the SoftAP SSID. MAC suffix is appended.

        config PLAIIIN_WIFI_AP_PASSWORD
            string "SoftAP password (empty = open)"
            default ""

        config PLAIIIN_HTTP_PORT
            int "HTTP server port"
            default 80
            range 1 65535
    endmenu

    menu "Pixel grouping (logical pixels)"
        config PLAIIIN_PX_GROUP_W
            int "Pixel-group width"
            default 1
            range 1 32
            help
                Combine N×M physical LEDs into one logical pixel.
                Default 1×1 means each LED is its own logical pixel.

        config PLAIIIN_PX_GROUP_H
            int "Pixel-group height"
            default 1
            range 1 32
    endmenu

    menu "Orientation"
        config PLAIIIN_ROTATION
            int "Rotation (degrees, multiples of 90)"
            default 0
            range 0 270

        config PLAIIIN_ORIGIN
            int "Origin corner (0=TL, 1=TR, 2=BL, 3=BR)"
            default 0
            range 0 3

        config PLAIIIN_SERPENTINE
            bool "Wiring zig-zags between rows/columns"
            default y

        config PLAIIIN_SERP_AXIS
            int "Chain axis (0=horizontal, 1=vertical)"
            default 0
            range 0 1
    endmenu

    menu "Buttons (touch / momentary)"
        config PLAIIIN_BTN_PWR_PIN
            int "On/Off button GPIO (-1 = none)"
            default -1
            help
                Active-low momentary or capacitive-touch button. Single
                tap toggles power; long-press 10 s triggers factory reset.

        config PLAIIIN_BTN_NEXT_PIN
            int "Next-script button GPIO (-1 = none)"
            default -1
            help
                Single tap calls /api/play/next when the lamp is in js mode.

        config PLAIIIN_BTN_PREV_PIN
            int "Previous-script button GPIO (-1 = none)"
            default -1
            help
                Single tap calls /api/play/prev when the lamp is in js mode.
    endmenu

endmenu
```

## sdkconfig.defaults
```kconfig
# PlaiiinLightOS baseline. A single universal firmware is built from this file
# plus version.properties — no profile-specific values are baked in. Hardware
# presets (lamp_type, led_count, pin, led_type, etc.) are applied during the
# first-boot onboarding flow, stored in NVS, and persist across OTA.
CONFIG_IDF_TARGET="esp32"
CONFIG_PARTITION_TABLE_CUSTOM=y
CONFIG_PARTITION_TABLE_CUSTOM_FILENAME="partitions.csv"
CONFIG_ESPTOOLPY_FLASHSIZE_4MB=y
CONFIG_ESP_WIFI_SOFTAP_SUPPORT=y
CONFIG_HTTPD_MAX_REQ_HDR_LEN=1024
CONFIG_HTTPD_MAX_URI_LEN=512
CONFIG_HTTPD_WS_SUPPORT=y
CONFIG_ESP_DEFAULT_CPU_FREQ_MHZ_240=y

# BLE (NimBLE) — required for the BT onboarding + control surface in Phase 7.
# BLE-only controller; coexists with WiFi STA on ESP32 (single radio, time-shared).
CONFIG_BT_ENABLED=y
CONFIG_BTDM_CTRL_MODE_BLE_ONLY=y
CONFIG_BTDM_CTRL_MODE_BR_EDR_ONLY=n
CONFIG_BTDM_CTRL_MODE_BTDM=n
CONFIG_BT_BLUEDROID_ENABLED=n
CONFIG_BT_NIMBLE_ENABLED=y
# Bigger MTU = fewer round-trips when uploading scripts over BLE.
CONFIG_BT_NIMBLE_ATT_PREFERRED_MTU=512
# WiFi IRAM optimization off — frees ~2 KB IRAM that the BT controller needs.
# Tradeoff: very small WiFi throughput cost (we don't push gigabit anyway).
CONFIG_ESP_WIFI_IRAM_OPT=n
CONFIG_ESP_WIFI_RX_IRAM_OPT=n

# Neutral hardware defaults — safe fallback until onboarding runs.
CONFIG_PLAIIIN_NODE_NAME="PlaiiinLight"
CONFIG_PLAIIIN_LED_PIN=2
CONFIG_PLAIIIN_LED_CLK_PIN=-1
CONFIG_PLAIIIN_LED_COUNT=30
CONFIG_PLAIIIN_LED_TYPE="ws2812"
CONFIG_PLAIIIN_LAMP_TYPE="strip"
CONFIG_PLAIIIN_FORM="bare"
CONFIG_PLAIIIN_NETWORK_SSID=""
CONFIG_PLAIIIN_NETWORK_PW=""

# Hardware buttons — disabled by default. Set per-profile in sdkconfig.<profile>
# or runtime via /api/config so a single firmware image fits all hardware revs.
CONFIG_PLAIIIN_BTN_PWR_PIN=-1
CONFIG_PLAIIIN_BTN_NEXT_PIN=-1
CONFIG_PLAIIIN_BTN_PREV_PIN=-1

# Pixel grouping & orientation defaults. Profiles override these per device,
# but a fresh device with no profile boots into 1:1 mapping at rotation 0.
CONFIG_PLAIIIN_PX_GROUP_W=1
CONFIG_PLAIIIN_PX_GROUP_H=1
CONFIG_PLAIIIN_ROTATION=0
CONFIG_PLAIIIN_ORIGIN=0
CONFIG_PLAIIIN_SERPENTINE=y
CONFIG_PLAIIIN_SERP_AXIS=0
```
